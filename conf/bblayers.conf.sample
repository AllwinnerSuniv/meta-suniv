## conf/bblayers.conf.sample
```bitbake
# POKY_BBLAYERS_CONF_VERSION is increased each time build/conf/bblayers.conf
# changes incompatibly
POKY_BBLAYERS_CONF_VERSION = "2"

BBPATH = "${TOPDIR}"
BSPDIR := "${@os.path.abspath(os.path.dirname(d.getVar('FILE', True)) + '/../..')}"

BBFILES ?= ""

BBLAYERS ?= " \
  ${BSPDIR}/yocto/poky/meta \
  ${BSPDIR}/yocto/poky/meta-poky \
  ${BSPDIR}/yocto/poky/meta-yocto-bsp \
  \
  ${BSPDIR}/yocto/meta-suniv \
  "
```

## conf/distro/include/suniv.inc
```bitbake
DISTRO = "lichee"
DISTRO_NAME = "lichee"
DISTRO_VERSION = "0.0.1"
SDK_VENDOR = "-lichee"
SDK_VERSION := "${@'${DISTRO_VERSION}'.replace('snapshot-${DATE}','snapshot')}"

MAINTAINER = "iotah <writeforever@foxmail.com>"

TARGET_VENDOR = "-lichee"

LOCALCONF_VERSION = "1"

SUNIV_DEFAULT_DISTRO_DEFATURES = "largefile ptest multiarch"

DISTRO_FEATURES ?= "${DISTRO_FEATURES_DEFAULT} ${DISTRO_FEATURES_LIBC} ${SUNIV_DEFAULT_DISTRO_FEATURES}"

SDK_NAME = "${DISTRO}-${TCLIBC}-${SDK_ARCH}-${IMAGE_BASENAME}-${TUNE_PKGARCH}"
SDKPATH = "/opt/${DISTRO}/${SDK_VERSION}"

PREMIRRORS ??= "\
bzr://.*/.*   https://mirror.iscas.ac.cn/yocto/mirror/sources/ \n \
cvs://.*/.*   https://mirror.iscas.ac.cn/yocto/mirror/sources/ \n \
git://.*/.*   https://mirror.iscas.ac.cn/yocto/mirror/sources/ \n \
gitsm://.*/.* https://mirror.iscas.ac.cn/yocto/mirror/sources/ \n \
hg://.*/.*    https://mirror.iscas.ac.cn/yocto/mirror/sources/ \n \
osc://.*/.*   https://mirror.iscas.ac.cn/yocto/mirror/sources/ \n \
p4://.*/.*    https://mirror.iscas.ac.cn/yocto/mirror/sources/ \n \
svn://.*/.*   https://mirror.iscas.ac.cn/yocto/mirror/sources/ \n"

MIRRORS =+ "\
ftp://.*/.*      https://mirror.iscas.ac.cn/yocto/mirror/sources/ \n \
http://.*/.*     https://mirror.iscas.ac.cn/yocto/mirror/sources/ \n \
https://.*/.*    https://mirror.iscas.ac.cn/yocto/mirror/sources/ \n"
```

## conf/distro/lichee.conf
```bitbake
include conf/distro/include/suniv.inc

GCCVERSION = "8.2.%"
GDBVERSION = "8.2.1"
GLIBCVERSION ?= "2.28"

PREFERRED_VERSION_gcc-cross-${TARGET_ARCH} ?= "8.2%"

PREFERRED_VERSION_u-boot = "2018%"
```

## conf/machine/include/suniv.inc
```bitbake
SOC_FAMILY = "suniv"
require conf/machine/include/soc-family.inc

require conf/machine/include/tune-arm926ejs.inc

# Increase this everytime when you change some thing in the kernel
MACHINE_KERNEL_REV = "r0"

KERNEL_IMAGETYPE = "zImage"

MACHINE_FEATURES += "keyboard vfat ext2 screen touchscreen alsa wifi sdio"

UBOOT_ENTRYPOINT = "0x80000000"
```

## conf/machine/suniv.conf
```bitbake
#@TYPE: Machine
#@NAME: Allwinner Suniv Development Board
#@DESCRIPTION: Machine configuration for the Allwinner Suniv Board

DEFAULTTUNE ?= "arm926ejs"

PREFERRED_VERSION_gcc-cross-${TARGET_ARCH} ?= "7.5%"

PREFERRED_PROVIDER_virtual/xserver = "xserver-xorg"
XSERVER = "xserver-xorg \
           xf86-input-evdev \
           xf86-video-modesetting \
           xf86-video-fbdev"

require conf/machine/include/suniv.inc

PREFERRED_PROVIDER_virtual/kernel = "linux-mainline"

IMAGE_FSTYPES_append = " tar.gz"

SERIAL_CONSOLES ?= "115200;ttyS1"

UBOOT_MACHINE = "suniv_config"
```
